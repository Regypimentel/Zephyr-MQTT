## PROJETO_FINAL_1.1/PROJETO_FINAL/build/Kconfig/boards/Kconfig.defconfig
```kconfig
# Load Zephyr board defconfig descriptions.
osource "/home/tesseract-0877/zephyrproject/zephyr/boards/espressif/esp_wrover_kit/Kconfig.defconfig"
```

## PROJETO_FINAL_1.1/PROJETO_FINAL/build/Kconfig/boards/Kconfig.esp_wrover_kit
```kconfig
# Load board Kconfig descriptions.
osource "/home/tesseract-0877/zephyrproject/zephyr/boards/espressif/esp_wrover_kit/Kconfig.esp_wrover_kit"
```

## PROJETO_FINAL_1.2/build/Kconfig/arch/Kconfig
```kconfig
# Load Zephyr Arch Kconfig descriptions.
osource "/home/tesseract-0877/zephyrproject/zephyr/arch/rx/Kconfig"
osource "/home/tesseract-0877/zephyrproject/zephyr/arch/x86/Kconfig"
osource "/home/tesseract-0877/zephyrproject/zephyr/arch/xtensa/Kconfig"
osource "/home/tesseract-0877/zephyrproject/zephyr/arch/sparc/Kconfig"
osource "/home/tesseract-0877/zephyrproject/zephyr/arch/riscv/Kconfig"
osource "/home/tesseract-0877/zephyrproject/zephyr/arch/posix/Kconfig"
osource "/home/tesseract-0877/zephyrproject/zephyr/arch/mips/Kconfig"
osource "/home/tesseract-0877/zephyrproject/zephyr/arch/arm64/Kconfig"
osource "/home/tesseract-0877/zephyrproject/zephyr/arch/arm/Kconfig"
osource "/home/tesseract-0877/zephyrproject/zephyr/arch/arc/Kconfig"
```

## PROJETO_FINAL_1.2/build/Kconfig/boards/Kconfig.defconfig
```kconfig
# Load Zephyr board defconfig descriptions.
osource "/home/tesseract-0877/zephyrproject/zephyr/boards/espressif/esp32_devkitc/Kconfig.defconfig"
```

## PROJETO_FINAL_1.2/build/Kconfig/boards/Kconfig.esp32_devkitc
```kconfig
# Load board Kconfig descriptions.
osource "/home/tesseract-0877/zephyrproject/zephyr/boards/espressif/esp32_devkitc/Kconfig.esp32_devkitc"
```
